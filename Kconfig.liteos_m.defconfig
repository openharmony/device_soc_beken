## Kconfig.liteos_m.defconfig
```kconfig
rsource "*/Kconfig.liteos_m.defconfig.series"

#config HALS_COMMUCATION_WIFI_LITE
#    bool "WIFI LITE"
#    default y
```

## bk7235/Kconfig.liteos_m.series
```kconfig
# Copyright (C) 2022 HiHope Open Source Organization .
# Licensed under the Apache License, Version 2.0 (the "License");
# you may not use this file except in compliance with the License.
# You may obtain a copy of the License at
#
# http://www.apache.org/licenses/LICENSE-2.0
#
# Unless required by applicable law or agreed to in writing, software
# distributed under the License is distributed on an "AS IS" BASIS,
# WITHOUT WARRANTIES OR CONDITIONS OF ANY KIND, either express or implied.
# See the License for the specific language governing permissions and
# limitations under the License.

config SOC_SERIES_BK7235
    bool "bk7235 Series"
    select RISC-V
    select SOC_COMPANY_BEKEN
    select CPU_RISCV32
    help
        Enable support for bk7235 series
```
